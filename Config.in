## Config.in
```kconfig
source "$BR2_EXTERNAL_BERT_PATH/package/rfm12b-linux/Config.in"
source "$BR2_EXTERNAL_BERT_PATH/package/freepbx/Config.in"
source "$BR2_EXTERNAL_BERT_PATH/package/asterisk-gui/Config.in"
source "$BR2_EXTERNAL_BERT_PATH/package/vcontrold/Config.in"
source "$BR2_EXTERNAL_BERT_PATH/package/home-assistant/Config.in"
source "$BR2_EXTERNAL_BERT_PATH/package/unifi-controller/Config.in"
source "$BR2_EXTERNAL_BERT_PATH/package/pysunspec/Config.in"
source "$BR2_EXTERNAL_BERT_PATH/package/python-appdaemon/Config.in"
```

## configs/asterisk_bbb_defconfig
```kconfig
BR2_arm=y
BR2_cortex_a8=y
BR2_GLOBAL_PATCH_DIR="$(BR2_EXTERNAL_BERT_PATH)/board/bbb/patches"
BR2_TOOLCHAIN_BUILDROOT_GLIBC=y
BR2_PACKAGE_HOST_LINUX_HEADERS_CUSTOM_4_4=y
BR2_TOOLCHAIN_BUILDROOT_CXX=y
BR2_TARGET_GENERIC_ISSUE="Welcome to BERTROOT"
BR2_TARGET_GENERIC_PASSWD_SHA256=y
BR2_TARGET_GENERIC_GETTY_PORT="ttyO0"
BR2_SYSTEM_DHCP="eth0"
BR2_ROOTFS_OVERLAY="$(BR2_EXTERNAL_BERT_PATH)/board/bbb/rootfs_overlay"
BR2_ROOTFS_POST_BUILD_SCRIPT="$(BR2_EXTERNAL_BERT_PATH)/board/bbb/post-build.sh"
BR2_ROOTFS_POST_IMAGE_SCRIPT="$(BR2_EXTERNAL_BERT_PATH)/board/bbb/post-image.sh"
BR2_LINUX_KERNEL=y
BR2_LINUX_KERNEL_CUSTOM_GIT=y
BR2_LINUX_KERNEL_CUSTOM_REPO_URL="git://git.ti.com/processor-sdk/processor-sdk-linux.git"
BR2_LINUX_KERNEL_CUSTOM_REPO_VERSION="f9f6f0db2d5e4f9d2ff46eb31a5a05276a92ed7d"
BR2_LINUX_KERNEL_DEFCONFIG="omap2plus"
BR2_LINUX_KERNEL_DTS_SUPPORT=y
BR2_LINUX_KERNEL_INTREE_DTS_NAME="am335x-evm am335x-bone am335x-boneblack am335x-bonegreen am335x-evmsk"
BR2_PACKAGE_BUSYBOX_CONFIG="$(BR2_EXTERNAL_BERT_PATH)/board/raspberrypi/busybox.config"
BR2_PACKAGE_PHP_SAPI_CGI=y
BR2_PACKAGE_PHP_SAPI_CLI=y
BR2_PACKAGE_PHP_EXT_SQLITE=y
BR2_PACKAGE_PHP_EXT_PDO=y
BR2_PACKAGE_PHP_EXT_PDO_SQLITE=y
BR2_PACKAGE_LIBGSM=y
BR2_PACKAGE_LIBVORBIS=y
BR2_PACKAGE_OPUS=y
BR2_PACKAGE_PORTAUDIO=y
BR2_PACKAGE_SPEEX=y
BR2_PACKAGE_OPENSSL=y
BR2_PACKAGE_UNIXODBC=y
BR2_PACKAGE_LIBPRI=y
BR2_PACKAGE_LIBSS7=y
BR2_PACKAGE_LIBXSLT=y
BR2_PACKAGE_FREERADIUS_CLIENT=y
BR2_PACKAGE_LIBPJSIP=y
BR2_PACKAGE_LIBURIPARSER=y
BR2_PACKAGE_NEON=y
BR2_PACKAGE_OPENLDAP=y
# BR2_PACKAGE_OPENLDAP_CLIENTS is not set
BR2_PACKAGE_LIBICAL=y
BR2_PACKAGE_DROPBEAR=y
BR2_PACKAGE_DROPBEAR_DISABLE_REVERSEDNS=y
BR2_PACKAGE_DROPBEAR_WTMP=y
BR2_PACKAGE_NETSNMP=y
BR2_PACKAGE_NTP=y
BR2_PACKAGE_RSYNC=y
BR2_TARGET_ROOTFS_EXT2=y
BR2_TARGET_ROOTFS_EXT2_4=y
BR2_TARGET_ROOTFS_EXT2_SIZE="250M"
# BR2_TARGET_ROOTFS_TAR is not set
BR2_TARGET_UBOOT=y
BR2_TARGET_UBOOT_BUILD_SYSTEM_KCONFIG=y
BR2_TARGET_UBOOT_CUSTOM_VERSION=y
BR2_TARGET_UBOOT_CUSTOM_VERSION_VALUE="2016.09.01"
BR2_TARGET_UBOOT_BOARD_DEFCONFIG="am335x_evm"
BR2_TARGET_UBOOT_NEEDS_DTC=y
# BR2_TARGET_UBOOT_FORMAT_BIN is not set
BR2_TARGET_UBOOT_FORMAT_IMG=y
BR2_TARGET_UBOOT_FORMAT_CUSTOM=y
BR2_TARGET_UBOOT_FORMAT_CUSTOM_NAME="spl/u-boot-spl.bin"
BR2_TARGET_UBOOT_SPL=y
BR2_TARGET_UBOOT_SPL_NAME="MLO"
BR2_PACKAGE_HOST_DOSFSTOOLS=y
BR2_PACKAGE_HOST_GENIMAGE=y
BR2_PACKAGE_HOST_MTOOLS=y
BR2_PACKAGE_FREEPBX=y
```

## configs/asterisk_rpi_defconfig
```kconfig
BR2_arm=y
BR2_arm1176jzf_s=y
BR2_PACKAGE_HOST_LINUX_HEADERS_CUSTOM_4_4=y
BR2_TOOLCHAIN_BUILDROOT_GLIBC=y
BR2_TOOLCHAIN_BUILDROOT_CXX=y
BR2_TARGET_GENERIC_ISSUE="Welcome to BERTROOT"
BR2_TARGET_GENERIC_PASSWD_SHA256=y
# BR2_TARGET_ENABLE_ROOT_LOGIN is not set
BR2_TARGET_GENERIC_GETTY_PORT="tty1"
BR2_SYSTEM_DHCP="eth0"
BR2_TARGET_TZ_INFO=y
BR2_ROOTFS_OVERLAY="$(BR2_EXTERNAL)/board/raspberrypi/rootfs_overlay"
BR2_ROOTFS_POST_BUILD_SCRIPT="$(BR2_EXTERNAL)/board/raspberrypi/post-build.sh"
BR2_ROOTFS_POST_IMAGE_SCRIPT="$(BR2_EXTERNAL)/board/raspberrypi/post-image.sh"
BR2_LINUX_KERNEL=y
BR2_LINUX_KERNEL_CUSTOM_GIT=y
BR2_LINUX_KERNEL_CUSTOM_REPO_URL="https://github.com/raspberrypi/linux.git"
BR2_LINUX_KERNEL_CUSTOM_REPO_VERSION="9669a50a3a8e4f33b4fe138277bc4407e1eab9b2"
BR2_LINUX_KERNEL_USE_CUSTOM_CONFIG=y
BR2_LINUX_KERNEL_CUSTOM_CONFIG_FILE="$(BR2_EXTERNAL)/board/raspberrypi/kernel.config"
BR2_LINUX_KERNEL_DTS_SUPPORT=y
BR2_LINUX_KERNEL_INTREE_DTS_NAME="bcm2708-rpi-b bcm2708-rpi-b-plus bcm2708-rpi-cm"
BR2_PACKAGE_BUSYBOX_CONFIG="$(BR2_EXTERNAL)/board/raspberrypi/busybox.config"
BR2_PACKAGE_RPI_FIRMWARE=y
# BR2_PACKAGE_RPI_FIRMWARE_INSTALL_DTB_OVERLAYS is not set
BR2_PACKAGE_ALSA_LIB=y
BR2_PACKAGE_MYSQL=y
BR2_PACKAGE_UNIXODBC=y
BR2_PACKAGE_JANSSON=y
BR2_PACKAGE_LIBXSLT=y
BR2_PACKAGE_LIBSRTP=y
BR2_PACKAGE_LIBURIPARSER=y
BR2_PACKAGE_NEON=y
BR2_PACKAGE_LIBICAL=y
BR2_PACKAGE_DROPBEAR=y
BR2_PACKAGE_DROPBEAR_DISABLE_REVERSEDNS=y
BR2_PACKAGE_DROPBEAR_WTMP=y
BR2_PACKAGE_NETSNMP=y
BR2_PACKAGE_NTP=y
BR2_PACKAGE_RSYNC=y
BR2_PACKAGE_UTIL_LINUX_LIBUUID=y
BR2_PACKAGE_DAHDI_LINUX=y
BR2_PACKAGE_OPENSSL=y
BR2_PACKAGE_ZLIB=y
BR2_PACKAGE_LIBXML2=y
BR2_PACKAGE_IKSEMEL=y
BR2_PACKAGE_LIBPRI=y
BR2_PACKAGE_LIBSRTP=y
BR2_PACKAGE_UW_IMAP=y
BR2_PACKAGE_SPANDSP=y
BR2_PACKAGE_DAHDI_LINUX=y
BR2_PACKAGE_SQLITE=y
BR2_PACKAGE_CURL=y
BR2_PACKAGE_PJSIP=y
BR2_TARGET_ROOTFS_EXT2=y
BR2_TARGET_ROOTFS_EXT2_4=y
# BR2_TARGET_ROOTFS_TAR is not set
BR2_PACKAGE_HOST_DOSFSTOOLS=y
BR2_PACKAGE_HOST_GENIMAGE=y
BR2_PACKAGE_HOST_MTOOLS=y
BR2_PACKAGE_ASTERISK=y
BR2_PACKAGE_ASTERISK_v13=y
BR2_PACKAGE_ASTERISK_MENUSELECT=y
BR2_PACKAGE_ASTERISK_GUI=y
```

## configs/rfmrpi_defconfig
```kconfig
BR2_arm=y
BR2_arm1176jzf_s=y
BR2_KERNEL_MIRROR="https://cdn.kernel.org/pub"
BR2_GNU_MIRROR="http://ftpmirror.gnu.org"
BR2_COMPILER_PARANOID_UNSAFE_PATH=y
BR2_PACKAGE_HOST_LINUX_HEADERS_CUSTOM_4_4=y
BR2_TOOLCHAIN_BUILDROOT_CXX=y
BR2_TARGET_GENERIC_ROOT_PASSWD="root"
BR2_SYSTEM_DHCP="eth0"
BR2_ROOTFS_OVERLAY="$(BR2_EXTERNAL)/board/raspberrypi/rootfs_overlay"
BR2_ROOTFS_POST_BUILD_SCRIPT="$(BR2_EXTERNAL)/board/raspberrypi/post-build.sh"
BR2_ROOTFS_POST_IMAGE_SCRIPT="$(BR2_EXTERNAL)/board/raspberrypi/post-image.sh"
BR2_LINUX_KERNEL=y
BR2_LINUX_KERNEL_CUSTOM_GIT=y
BR2_LINUX_KERNEL_CUSTOM_REPO_URL="https://github.com/raspberrypi/linux.git"
BR2_LINUX_KERNEL_CUSTOM_REPO_VERSION="26f3b72a9c049be10e6af196252283e1f6ab9d1f"
BR2_LINUX_KERNEL_USE_CUSTOM_CONFIG=y
BR2_LINUX_KERNEL_CUSTOM_CONFIG_FILE="$(BR2_EXTERNAL)/board/raspberrypi/kernel.config"
BR2_LINUX_KERNEL_DTS_SUPPORT=y
BR2_LINUX_KERNEL_INTREE_DTS_NAME="bcm2708-rpi-b bcm2708-rpi-b-plus bcm2708-rpi-cm"
BR2_PACKAGE_RPI_FIRMWARE=y
# BR2_PACKAGE_RPI_FIRMWARE_INSTALL_DTB_OVERLAYS is not set
BR2_PACKAGE_DROPBEAR=y
BR2_PACKAGE_WPA_SUPPLICANT=y
BR2_PACKAGE_WPA_SUPPLICANT_AP_SUPPORT=y
BR2_PACKAGE_WPA_SUPPLICANT_WPS=y
BR2_PACKAGE_WPA_SUPPLICANT_CLI=y
BR2_PACKAGE_WPA_SUPPLICANT_WPA_CLIENT_SO=y
BR2_PACKAGE_WPA_SUPPLICANT_PASSPHRASE=y
BR2_TARGET_ROOTFS_EXT2=y
BR2_TARGET_ROOTFS_EXT2_4=y
# BR2_TARGET_ROOTFS_TAR is not set
BR2_PACKAGE_HOST_DOSFSTOOLS=y
BR2_PACKAGE_HOST_GENIMAGE=y
BR2_PACKAGE_HOST_MTOOLS=y
BR2_PACKAGE_RFM12B_LINUX=y
```

## package/freepbx/Config.in
```kconfig
config BR2_PACKAGE_FREEPBX
	bool "freepbx"
	default n
	select BR2_PACKAGE_SQLITE
	select BR2_PACKAGE_HOST_SQLITE
	select BR2_PACKAGE_ASTERISK
	select BR2_PACKAGE_PHP
	help
	  Freepbx
```

## package/home-assistant/Config.in
```kconfig
config BR2_PACKAGE_HOME_ASSISTANT
	bool "home-assistant"
	select BR2_PACKAGE_PYTHON3
	help
	  Home Assistant is an open-source home automation platform running on Python 3. Track and control all devices at home and automate control.
	  Perfect to run on a Raspberry Pi. 
	  https://home-assistant.io
	  https://github.com/home-assistant/home-assistant
```

## package/pysunspec/Config.in
```kconfig
config BR2_PACKAGE_PYSUNSPEC
	bool "pySynSpec"
	depends on BR2_PACKAGE_PYTHON3
	help
	  pySunSpec
	  https://github.com/sunspec/pysunspec
```

## package/python-appdaemon/Config.in
```kconfig
config BR2_PACKAGE_PYTHON_APPDAEMON
	bool "python-appdaemon"
  select BR2_PACKAGE_PYTHON3
	help
	  AppDaemon is a loosely coupled, multithreaded, sandboxed python execution environment for writing automation apps for Home Assistant home automation software. As of release 2.0.0 it also provides a configurable dashboard (HADashboard) suitable for wall mounted tablets.

	  https://github.com/home-assistant/appdaemon
```

## package/rfm12b-linux/Config.in
```kconfig
config BR2_PACKAGE_RFM12B_LINUX
        bool "rfm12b-linux"
        help
          A Linux kernel SPI-driver for the RFM12B RF module by HopeRF

          https://github.com/gkaindl/rfm12b-linux
```

## package/unifi-controller/Config.in
```kconfig
config BR2_PACKAGE_UNIFI_CONTROLLER
	bool "unifi-controller"
	depends on BR2_PACKAGE_JAMVM
	help
	  Ubiquiti networks unifi controller
```

## package/vcontrold/Config.in
```kconfig
config BR2_PACKAGE_VCONTROLD
	bool "vcontrold"
	select BR2_PACKAGE_LIBXML2
	help
	  vcontrold Daemon for control and logging of Viessmann type heating devices
	  https://github.com/openv/openv/wiki

if BR2_PACKAGE_VCONTROLD

config BR2_PACKAGE_VCONTROLD_VCLIENT
	bool "vclient"
	help
	  Build the vclient helper program (for communication with vcontrold)

config BR2_PACKAGE_VCONTROLD_VSIM
	bool "vsim"
	help
	  Build the vsim helper program (for development and testing purposes)

endif
```
